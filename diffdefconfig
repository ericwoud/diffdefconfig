## diffdefconfig
```kconfig
#!/bin/bash

DEFCONFIG="defconfig"
ARCH="arm64"
WORK="./diffdef"

mkdir -p $WORK

if [ $# == 1 ]; then
  CONFIG[2]=$1
  CONFIG[1]=$WORK/$DEFCONFIG.config
  make ARCH=$ARCH $DEFCONFIG
  cp .config ${CONFIG[1]}
elif [ $# == 2 ]; then
  CONFIG[1]=$1
  CONFIG[2]=$2
elif [ $# == 3 ]; then
  if [ $1 == "-d" ]; then
    CONFIG[2]=$3
    CONFIG[1]=$WORK/$2.config
    make ARCH=$ARCH $2
    cp .config ${CONFIG[1]}
  fi
else
  echo "First set the correct ARCH=..."
  echo
  echo "Be carefull: current kernel's .config will be lost!"
  echo
  echo "Usage: diffdefconfig [-d DEFCONFIG] [SOURCE] TARGET"
  echo
  echo "Current directory must be in root of kernel."
  echo
  echo "If no SOURCE specified then source will be a .config made from" 
  echo "defconfig set by the -d option (default = defconfig)."
  echo
  echo "Example: 'diffdefconfig -d mvebu_v7_defconfig myconfig.config', result in diff_defconfig"
  echo "You can use the diff_defconfig file as follows:"
  echo
  echo "cp arch/arm/configs/mvebu_v7_defconfig arch/arm/configs/merged_defconfig"
  echo "cat diffdef/diff_defconfig           >>arch/arm/configs/merged_defconfig"
  echo "make ARCH=arm merged_defconfig"
  echo
  echo "The resulting .config will be the same as the original myconfig.config."
  echo
  echo "Example: 'diffdefconfig myconfig1.config myconfig2.config'"
  echo
  echo "Compares .config files, list changes except kconfig's defaults."
  exit
fi

###########################################################################
# Make diffconfig2/3, they are a little different from scripts/diffconfig #
###########################################################################
cp ./scripts/diffconfig $WORK/diffconfig2
patch -d $WORK/ -p1 -N -r - <<'EOF'
--- ./diffconfig2	2019-06-28 21:17:51.712841593 +0200
+++ ./diffconfig2	2019-06-28 21:17:00.112308932 +0200
@@ -59,2 +59,5 @@
                 print("CONFIG_%s=%s" % (config, new_value))
+        else:                                            #########
+            if op=="-":                                  # ADDED #
+                print("# CONFIG_%s is not set" % config) #########
     else:
EOF
cp ./scripts/diffconfig $WORK/diffconfig3
patch -d $WORK/ -p1 -N -r - <<'EOF'
--- ./diffconfig3	2019-06-28 21:17:51.712841593 +0200
+++ ./diffconfig3	2019-06-28 21:17:00.112308932 +0200
@@ -54,3 +54,3 @@
     if merge_style:
-        if new_value:
+        if new_value and op=="->":   ### CHANGED ###
             if new_value=="n":
EOF

######################################
# Make allyes.config with extras     #
# Add more allyes extras below 'cat' #
######################################
filename=$WORK/allyes.config
cat >$WORK/allyesextra <<'EOF'
CONFIG_CMDLINE="yes"
CONFIG_CMDLINE_FORCE=y
# CONFIG_LOCALVERSION_AUTO is not set
CONFIG_COMPILE_TEST=n
CONFIG_PREEMPT=y
CONFIG_CPU_BIG_ENDIAN=n
EOF
make KCONFIG_ALLCONFIG=$WORK/allyesextra ARCH=$ARCH allyesconfig
cp ./.config $filename

###################################
# Make diff_defconfig_unformatted #
###################################
for i in {1..2}
do
  cp ${CONFIG[$i]} .config
  make ARCH=$ARCH olddefconfig
  make ARCH=$ARCH savedefconfig
  cp ./defconfig "$WORK/config"$i"_defconfig"
  cp ./.config   "$WORK/config"$i".config"
done
$WORK/diffconfig2 -m $WORK/config1_defconfig $WORK/config2_defconfig >$WORK/diff_defconfig_unformatted

######################################################
# Add choices #
######################################################
cp $WORK/config1_defconfig ./arch/$ARCH/configs/testmerged_defconfig
cat $WORK/diff_defconfig_unformatted >>./arch/$ARCH/configs/testmerged_defconfig
make ARCH=$ARCH testmerged_defconfig
$WORK/diffconfig3 -m ./.config $WORK/config2.config >>$WORK/diff_defconfig_unformatted

######################################################
# Check if diff_defconfig_unformatted actually works #
######################################################
cp $WORK/config1_defconfig ./arch/$ARCH/configs/testmerged_defconfig
cat $WORK/diff_defconfig_unformatted >>./arch/$ARCH/configs/testmerged_defconfig
make ARCH=$ARCH testmerged_defconfig
echo PRINTING DIFFERENCES diff_defconfig_unformatted, SHOULD BE NONE
./scripts/diffconfig ./.config $WORK/config2.config
echo PRINTING DIFFERENCES diff_defconfig_unformatted, DONE
rm -f ./arch/$ARCH/configs/testmerged_defconfig

###############################################################################
# Format the diff_defconfig, uses allyes.config, if not perfect, needs extras #
###############################################################################
countconfig=0
echo -e "#\n# diff_defconfig file build by:\n#   https://github.com/ericwoud/diffdefconfig.git" >$WORK/diff_defconfig
while read line; do
    if [[ ! -z "$line" ]]; then
      string=""
      if [[ ${line:0:7} == 'CONFIG_' ]]; then
        string="${line%%=*}"            # remove all text after DOT and store in variable s
      elif [[ ${line:0:9} == '# CONFIG_' ]]; then
        string=${line%' is not set'}
        string=${string:2}
      fi
      if [[ ! -z "$string" ]]; then
        lineout=$(grep "$string[ =]" $WORK/diff_defconfig_unformatted)
        if [ -n "$lineout" ]; then
          echo -e "$lineout" >>$WORK/diff_defconfig
          countconfig=$((countconfig+1))
          echo Formatting line nr: $countconfig
          tput cuu1 # scroll up
        fi
      else
        echo -e "$line" >>$WORK/diff_defconfig
      fi
    else
      echo -e "" >>$WORK/diff_defconfig
    fi
done < $filename

#######################################################################
# Clean up the diff_defconfig, leave out the comments with no options #
#######################################################################
while [[ $changed != "false" ]]; do
  changed="false"
  readarray -t fileout < $WORK/diff_defconfig
  for (( i=3; i<${#fileout[@]}; i++ ))
  do  
    if [[ ${fileout[i-3]} == '#' ]]; then
      if [[ ${fileout[i-2]:0:2} == '# ' ]]; then
        if [[ ${fileout[i-1]} == '#' ]]; then
          endof='# end of'${fileout[i-2]/'#'}
          if [[ ${fileout[i]} == "$endof" ]]; then
            fileout[i-3]="&"
            fileout[i-2]="&"
            fileout[i-1]="&"
            fileout[i]="&"
            changed="true"
          elif [[ ${fileout[i]:0:7} != 'CONFIG_' ]]  && [[ ${fileout[i]:0:9} != '# CONFIG_' ]]; then
            test="$(grep -F "$endof" $WORK/diff_defconfig)"
            if [ -z "$test" ] || [[ ${fileout[i-2]} == '# Boot options' ]]; then
              fileout[i-3]="&"
              fileout[i-2]="&"
              fileout[i-1]="&"
              changed="true"
            fi
          fi
        fi
      fi
    fi
    if [[ ${fileout[i-1]} == '' ]]; then
      if [[ ${fileout[i]} == '' ]]; then
        fileout[i-1]="&"
        changed="true"
      elif [[ ${fileout[i]:0:9} == '# end of ' ]]; then
        fileout[i-1]="&"
        changed="true"
      elif [[ ${fileout[i-2]:0:7} == 'CONFIG_' ]]  || [[ ${fileout[i-2]:0:9} == '# CONFIG_' ]]; then
        if [[ ${fileout[i]:0:7} == 'CONFIG_' ]]  || [[ ${fileout[i]:0:9} == '# CONFIG_' ]]; then
          fileout[i-1]="&"
          changed="true"
        fi
      fi
    fi
  done  
  echo -e -n "" >$WORK/diff_defconfig
  for lineout in "${fileout[@]}"; do
    if [[ "$lineout" != "&" ]]; then
     echo -e "$lineout" >>$WORK/diff_defconfig
    fi
  done
done

echo PRINTING DIFFERENCES check formatting, SHOULD BE NONE
$WORK/diffconfig2 $WORK/diff_defconfig_unformatted $WORK/diff_defconfig
echo PRINTING DIFFERENCES check formatting, DONE
echo If there are differences after formatting found, you need to add the CONFIG_* 
echo to the allyes extras inside the script with any value. The value is not used.

##########################################
# Check if diff_defconfig actually works #
##########################################
cp $WORK/config1_defconfig ./arch/$ARCH/configs/testmerged_defconfig
cat $WORK/diff_defconfig >>./arch/$ARCH/configs/testmerged_defconfig
make ARCH=$ARCH testmerged_defconfig
echo PRINTING DIFFERENCES diff_defconfig, SHOULD BE NONE
$WORK/diffconfig2 ./.config $WORK/config2.config
echo PRINTING DIFFERENCES diff_defconfig, DONE
rm -f ./arch/$ARCH/configs/testmerged_defconfig

echo -e "\nALL DONE. IF NO DIFFERENCES PRINTED YOU CAN USE $WORK/diff_defconfig"

exit 0
```
